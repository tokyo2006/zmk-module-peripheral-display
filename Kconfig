## Kconfig
```kconfig
# Top-level gate
config ZMK_PERIPHERAL_DISPLAY
    bool "Peripheral-side status display (zmk-module-peripheral-display)"
    default n
    help
      Enable the peripheral display module. The peripheral side of a
      split keyboard renders the central's status (layer, mods, WPM,
      battery, HID, output, bongo cat) on a Sharp LS013B7DH03
      128x128 mono memory LCD.

# T6 forward
config ZMK_PERIPHERAL_STATUS_FORWARD
    bool "Enable central-side status forwarding"
    default y
    depends on ZMK_PERIPHERAL_DISPLAY && ZMK_SPLIT_ROLE_CENTRAL
    help
      Central packs zmk_status_adv_data and notifies the peripheral
      over a custom GATT characteristic.

# T7 receive
config ZMK_PERIPHERAL_STATUS_RECEIVE
    bool "Enable peripheral-side status receiving"
    default y
    depends on ZMK_PERIPHERAL_DISPLAY && !ZMK_SPLIT_ROLE_CENTRAL
    help
      Peripheral subscribes to the central's notify characteristic
      and writes incoming data into the shadow state.

# T8 widgets gate (referenced by T8's CMakeLists line above)
config ZMK_PERIPHERAL_DISPLAY_WIDGETS
    bool "Build peripheral display widgets and LVGL screen"
    default y
    depends on ZMK_PERIPHERAL_DISPLAY && !ZMK_SPLIT_ROLE_CENTRAL

# T9d modifiers widget style (Mac vs Windows icons).
# Widgets read IS_ENABLED(CONFIG_ZMK_PERIPHERAL_DISPLAY_MODIFIERS_STYLE_MAC),
# so this must be a real boolean symbol (not an integer).
choice ZMK_PERIPHERAL_DISPLAY_MODIFIERS_STYLE
    prompt "Modifier icon style"
    default ZMK_PERIPHERAL_DISPLAY_MODIFIERS_STYLE_WIN
    help
      0 = Windows icons (WIN/Ctrl/Alt/Shift)
      1 = Mac icons (⌘ ⌥ ⌃ ⇧)

config ZMK_PERIPHERAL_DISPLAY_MODIFIERS_STYLE_WIN
    bool "Windows icons"

config ZMK_PERIPHERAL_DISPLAY_MODIFIERS_STYLE_MAC
    bool "Mac icons"
endchoice

# Per-widget toggles (T8/T9). Each widget's .c is compiled and its init
# call uncommented in peripheral_display.c when its symbol is enabled.

config ZMK_PERIPHERAL_DISPLAY_WIDGET_LAYER
    bool "Layer status widget"
    default y
    depends on ZMK_PERIPHERAL_DISPLAY_WIDGETS

config ZMK_PERIPHERAL_DISPLAY_WIDGET_OUTPUT
    bool "Output status widget"
    default y
    depends on ZMK_PERIPHERAL_DISPLAY_WIDGETS

config ZMK_PERIPHERAL_DISPLAY_WIDGET_BATTERY
    bool "Battery status widget"
    default y
    depends on ZMK_PERIPHERAL_DISPLAY_WIDGETS

config ZMK_PERIPHERAL_DISPLAY_WIDGET_MODIFIERS
    bool "Modifiers widget"
    default y
    depends on ZMK_PERIPHERAL_DISPLAY_WIDGETS

config ZMK_PERIPHERAL_DISPLAY_WIDGET_HID_INDICATORS
    bool "HID indicators widget"
    default y
    depends on ZMK_PERIPHERAL_DISPLAY_WIDGETS

config ZMK_PERIPHERAL_DISPLAY_WIDGET_WPM
    bool "WPM widget"
    default y
    depends on ZMK_PERIPHERAL_DISPLAY_WIDGETS

config ZMK_PERIPHERAL_DISPLAY_WIDGET_CENTRAL_NAME
    bool "Central name widget"
    default n
    depends on ZMK_PERIPHERAL_DISPLAY_WIDGETS

config ZMK_PERIPHERAL_DISPLAY_WIDGET_BONGO_CAT
    bool "Bongo cat widget"
    default y
    depends on ZMK_PERIPHERAL_DISPLAY_WIDGETS

# ASDC BLE L2CAP data channel (central -> peripheral)
rsource "src/asdc/Kconfig"
```

## boards/shields/peripheral_lcd_ls013/Kconfig.shield
```kconfig
config SHIELD_PERIPHERAL_LCD_LS013
    def_bool $(shields_list_contains,peripheral_lcd_ls013)
```

## dts/bindings/zmk,peripheral-display-asdc.yaml
```yaml
description: |
  Allows defining arbitrary split data channel

compatible: "zmk,peripheral-display-asdc"

properties:
  channel-id:
    type: int
    required: true
    description: the id of this data channel, an integer.
```

## src/asdc/Kconfig
```kconfig
DT_COMPAT_ZMK_PERIPHERAL_DISPLAY_ASDC := zmk,peripheral-display-asdc

config ZMK_ARBITRARY_SPLIT_DATA_CHANNEL
    bool
    default $(dt_compat_enabled,$(DT_COMPAT_ZMK_PERIPHERAL_DISPLAY_ASDC))
    select BT_L2CAP_DYNAMIC_CHANNEL

config ZMK_ARBITRARY_SPLIT_DATA_CHANNEL_TX_QUEUE_SIZE
    int "Max number of data events to queue when sending"
    default 30
    depends on ZMK_ARBITRARY_SPLIT_DATA_CHANNEL

config ZMK_ARBITRARY_SPLIT_DATA_CHANNEL_RX_QUEUE_SIZE
    int "Max number of data events to queue when receiving"
    default 20
    depends on ZMK_ARBITRARY_SPLIT_DATA_CHANNEL

config ZMK_BT_ASDC_L2CAP_PSM
    hex "L2CAP PSM for Arbitrary Split Data Channel"
    default 0x0080
    depends on ZMK_ARBITRARY_SPLIT_DATA_CHANNEL
```
